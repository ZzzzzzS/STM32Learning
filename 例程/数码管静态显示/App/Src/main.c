/**********************718创新实验室开发板例程*********************
*  编写：718创新实验室
*  平台：STM32F103VET6
*  说明：由于作者的水平有限，若有不足之处，还请大家谅解。
*		 建议大家多看看数据手册。     
******************************************************************/
/*************************功能说明********************************
数码管静态显示
*************************功能说明********************************/

#include "stm32f10x.h"
#include "module_74hc595.h"


void Delay1s()//硬延时函数
{
	unsigned char i, j, k;
	i = 92;
	j = 27;
	k = 14;
	do
	{
		do
		{
			while (--k);
		} while (--j);
	} while (--i);
}

void main()
{
	int i;
	hc595_init();				//数码管初始化
	
	while(1)
	{
		for(i = 0;i < 16;i++)
		{
			DisplayScan(0,data_table[i]);           // 显示数字
			Delay1s();
		}				
		
	} 
}
